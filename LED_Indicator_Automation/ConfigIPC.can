/*@!Encoding:1252*/
includes
{
  
}

variables
{
  
}

on message BCMMessage
{
  @LED::Sys_IPC = this.BCM_Signal;
}

